## sdkconfig.defaults
```kconfig
# ------------------------------------------------------------------
# Project-wide ESP-IDF config overrides.
# Edit menuconfig if you need more; this file just nails the must-haves.
# ------------------------------------------------------------------

# --- Flash ---
CONFIG_ESPTOOLPY_FLASHSIZE_16MB=y
CONFIG_ESPTOOLPY_FLASHSIZE="16MB"
CONFIG_PARTITION_TABLE_CUSTOM=y
CONFIG_PARTITION_TABLE_CUSTOM_FILENAME="partitions.csv"

# --- PSRAM (octal, ESP32-S3-WROOM-2 / R8 variants) ---
CONFIG_SPIRAM=y
CONFIG_SPIRAM_MODE_OCT=y
CONFIG_SPIRAM_TYPE_AUTO=y
CONFIG_SPIRAM_SPEED_80M=y
CONFIG_SPIRAM_USE_MALLOC=y
CONFIG_SPIRAM_TRY_ALLOCATE_WIFI_LWIP=y
# Buffers below this size stay in internal RAM (DMA-capable, fast).
CONFIG_SPIRAM_MALLOC_ALWAYSINTERNAL=16384

# --- CPU ---
CONFIG_ESP_DEFAULT_CPU_FREQ_MHZ_240=y
CONFIG_FREERTOS_HZ=1000

# --- Main task stack ---
# app_main runs the whole cycle on the main task: provisioning (httpd + mDNS +
# DNS bringup) or the REST path (esp_http_client + TLS + cJSON + image decode).
# The 3584-byte default overflows; 8 KB gives comfortable headroom.
CONFIG_ESP_MAIN_TASK_STACK_SIZE=8192

# --- Networking ---
CONFIG_LWIP_LOCAL_HOSTNAME="tesserae-esp32"

# WiFi: STA + AP simultaneously (we need AP during provisioning)
CONFIG_ESP_WIFI_ENABLE_WPA3_SAE=y

# --- TLS / HTTPS via mbedTLS bundled root CAs ---
# Lets esp_http_client + esp-tls validate arbitrary public HTTPS endpoints
# without us embedding any certs.
CONFIG_ESP_TLS_USING_MBEDTLS=y
CONFIG_MBEDTLS_CERTIFICATE_BUNDLE=y
CONFIG_MBEDTLS_CERTIFICATE_BUNDLE_DEFAULT_FULL=y

# --- MQTT (5 is overkill for our use case; 3.1.1 is rock solid) ---
CONFIG_MQTT_PROTOCOL_311=y

# --- HTTP server (for SoftAP captive portal) ---
CONFIG_HTTPD_MAX_REQ_HDR_LEN=1024
CONFIG_HTTPD_MAX_URI_LEN=512

# --- Logging ---
CONFIG_LOG_DEFAULT_LEVEL_INFO=y
CONFIG_LOG_COLORS=y

# --- Console: route app logs + panic backtraces to UART0 so they come out the
# onboard USB-serial bridge (CH340, the USB-C port we flash through) on every
# board -- not just the ESP32-S3 native USB-Serial-JTAG. UART0 stays primary;
# USB-Serial-JTAG remains a secondary console (native USB, when connected).
# Verified on the reTerminal E1004: full boot + app logs over the CH340 @115200
# (matches monitor_speed in platformio.ini). This is already the IDF default,
# pinned here so a board/PlatformIO variant can't silently reroute it. ---
CONFIG_ESP_CONSOLE_UART_DEFAULT=y
CONFIG_ESP_CONSOLE_SECONDARY_USB_SERIAL_JTAG=y

# --- Power: we want explicit control, not the IDF power-management hooks ---
CONFIG_PM_ENABLE=n

# --- IPv6 (issue #2): reach servers that only listen on IPv6 ---
# CONFIG_LWIP_IPV6 itself is the IDF default; SLAAC is not. With autoconf on,
# the device forms a routable (global/ULA) address from router advertisements.
# wifi_manager creates the required link-local address on association; DNS AAAA
# resolution and v6 connects then work through the stock lwIP/esp-tls path
# whenever that is what a hostname resolves to. IPv4 behaviour is unchanged.
CONFIG_LWIP_IPV6_AUTOCONFIG=y
```
